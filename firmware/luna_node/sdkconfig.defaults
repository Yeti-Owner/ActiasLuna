## firmware/luna_node/sdkconfig.defaults
```kconfig
CONFIG_IDF_TARGET="esp32s3"
CONFIG_ESPTOOLPY_FLASHSIZE_16MB=y
CONFIG_ESPTOOLPY_FLASHMODE_QIO=y
CONFIG_COMPILER_OPTIMIZATION_PERF=y
CONFIG_FREERTOS_HZ=1000
CONFIG_ESP_WIFI_CSI_ENABLED=y
CONFIG_LWIP_MAX_SOCKETS=24
CONFIG_LWIP_DHCPS_MAX_STATION_NUM=15
CONFIG_HTTPD_MAX_REQ_HDR_LEN=1024
CONFIG_LOG_DEFAULT_LEVEL_INFO=y
```
